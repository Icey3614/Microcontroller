#include "buzzer.h"
#include "timer.h"
// 无源蜂鸣器
/*
单片机驱动无源蜂鸣器演奏音乐，核心原理是**输出特定频率的方波信号**，
而非改变电压的高低数值。无源蜂鸣器内部无振荡源，必须依赖外部脉冲来驱动：
当单片机I/O口以固定频率快速切换高低电平（即输出方波）时，
蜂鸣器内的压电片或电磁线圈会随电平跳变而机械振动，从而发出声音。
方波的频率决定了振动的快慢，也就决定了音调的高低——频率越高，
声音越尖锐；频率越低，声音越低沉。音乐中的每个音符（Do、Re、Mi等）都对应一个标准频率，
因此只需查表得到音符的频率值，再用单片机的定时器产生该频率的方波，即可发出对应的音调。
同时，通过控制每个方波持续输出的时间（即延时或定时器计时），就能决定音符的节拍长短。
将乐谱中的音符和节拍逐一转换为频率与时长序列，由单片机依次输出对应的方波，
蜂鸣器便会连续奏出旋律。为获得足够驱动电流，通常还需用三极管搭建开关电路放大信号。
简而言之：频率定音调，时长定节拍，顺序输出即奏乐。
*/
// 音律频率表：49个音律对应的 TH1 / TL1 计数初值 
static u8 code T[49][2] = {
    {0,0},
    {0xF9,0x1F},{0xF9,0x82},{0xF9,0xDF},{0xFA,0x37},{0xFA,0x8A},{0xFA,0xD8},
    {0xFB,0x23},{0xFB,0x68},{0xFB,0xAA},{0xFB,0xE9},{0xFC,0x24},{0xFC,0x5B},
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    {0xFF,0x64},{0xFF,0x6D},{0xFF,0x75},{0xFF,0x7D},{0xFF,0x84},{0xFF,0x8B}
};

// 青花瓷标准曲谱数据：{音律号, 节拍数} 
static u8 code qinghuaci[][2] = {
    {0,4}, // [cite: 1014]
    {0,1},{1,1},{3,1},{5,1},{6,1},{8,1},{10,1},{12,1},{13,1}, 
    {0,1},{13,1},{15,1},{17,1},{18,1},{20,1},{22,1},{24,1},{25,1},
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    {0xFF,0xFF}
};

static volatile u8 idata m = 0;               // 当前音符的音律索引 
static volatile u16 idata song_index = 0;     // 曲谱数组指针 
static volatile bit is_playing = 0;           // 播放状态机开关 
static volatile u16 idata beat_ms_remain = 0; // 当前音符总剩余毫秒数 

#define BASE_BEAT_MS   35   // 标准基准时序：1/16节拍长度定义为 35 毫秒 
#define SILENT_GAP_MS  15   // 音符末尾强制静音 15 毫秒，用于物理清爽切音，去除模糊感 

/*******************************************************************************
* 函 数 名: T1_ISR_Buzzer (中断号 3)
* 功能描述: 纯净的独立音调发生器，排除Timer0多任务带来的时序挤压 
*******************************************************************************/
void T1_ISR_Buzzer(void) interrupt 3
{
    Beep = !Beep;                // 物理高低电平翻转，驱动被动式蜂鸣器发声
    TH1 = T[m][0];               // 重新装载高8位初值 
    TL1 = T[m][1];               // 重新装载低8位初值
}

void Buzzer_PlayQingHuaCi(void)
{
    song_index = 0; // 
    beat_ms_remain = 0; // 
    is_playing = 1; // 
}

void Buzzer_Stop(void)
{
    TR1 = 0;                     // 停止 Timer1
    ET1 = 0;                     // 关闭 Timer1 中断 
    is_playing = 0; // [cite: 1057]
    Beep = 1;                    // 强行拉高释放 P2.5 总线，供 LCD1602 正常刷新 
}

bit Buzzer_IsPlaying(void)
{
    return is_playing;
}

/*******************************************************************************
* 函 数 名: Buzzer_BeatTick
* 功能描述: 非阻塞毫秒时钟减法器，必须由 Timer0 的 1ms 中断服务程序（T0_ISR）调用 
*******************************************************************************/
void Buzzer_BeatTick(void)
{
    if (is_playing && beat_ms_remain > 0)
    {
        beat_ms_remain--; 

        // 核心切音逻辑：当音符即将播放完毕，进入最后的静音窗口时，强行关闭声音 
        if (beat_ms_remain <= SILENT_GAP_MS && m != 0) 
        {
            TR1 = 0;             // 关闭定时器 
            ET1 = 0;             // 关中断 
            Beep = 1;            // 释放总线，制造完美声学间隙 
        }
    }
}

/*******************************************************************************
* 函 数 名: Buzzer_Service
* 功能描述: 主状态机轮询函数，置于 main.c 的主循环内高效运转 [cite: 1083, 1084]
*******************************************************************************/
void Buzzer_Service(void)
{
    u8 note_type; //
    u8 duration; //

    if (!is_playing) return; //
    if (beat_ms_remain > 0) return; // 当前音符（含切音期）未消耗完毕，直接退出

    // 读取当前谱表节点信息
    note_type = qinghuaci[song_index][0]; //
    duration  = qinghuaci[song_index][1]; //

    // 1. 判断是否到达歌曲终点 
    if (note_type == 0xFF) // 
    {
        TR1 = 0; ET1 = 0; Beep = 1; //
        song_index = 0;                            // 自动回到第一首开头循环播放 [cite: 1099]
        beat_ms_remain = 30 * BASE_BEAT_MS;        // 曲终休止停顿 [cite: 1100]
        return; // 
    }

    // 2. 解析当前音律并转换为毫秒级时间窗
    m = note_type; // 
    beat_ms_remain = (u16)duration * BASE_BEAT_MS; // 

    // 3. 驱动硬件执行对应发声时序 
    if (m == 0x00) // 简谱中的休止符 '0' 
    {
        TR1 = 0; // 
        ET1 = 0; //
        Beep = 1;  // 维持静音 
    }
    else           // 有音高振幅的标准音符 
    {
        TH1 = T[m][0]; // 
        TL1 = T[m][1]; // 
        TR1 = 1;   // 唤醒定时器 
        ET1 = 1;   // 开启发声中断 
    }

    song_index++;  // 指针无阻塞地平滑递增，指向下一个待播放音符
}