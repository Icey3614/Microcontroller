#include "uart.h"
#include <string.h>

static u8 idata rx_buffer = 0;       // 接收缓冲
static bit rx_flag = 0;        // 接收完成标志
static bit uart_mode = 0;      // 串口模式标志

/*******************************************************************************
* 函 数 名: UART_Init
* 函数功能: 初始化串口，9600bps @11.0592MHz
* 说    明: 使用T1作为波特率发生器，方式2（8位自动重载）
*******************************************************************************/
void UART_Init(void)
{
    // 串口方式1（8位UART），T1方式2（8位自动重载）
    SCON = 0x50;                     // 方式1, REN=1允许接收
    TMOD = (TMOD & 0x0F) | 0x20;    // T1工作在方式2（8位自动重载）
    TH1 = 0xFD;                      // 9600bps @11.0592MHz
    TL1 = 0xFD;
    TR1 = 1;                         // 启动T1
    ES = 1;                          // 开串口中断
    EA = 1;                          // 开总中断（若已开则无影响）
}

/*******************************************************************************
* 函 数 名: UART_SendByte
* 函数功能: 发送一个字节
*******************************************************************************/
void UART_SendByte(u8 dat)
{
    SBUF = dat;
    while (!TI);                     // 等待发送完成
    TI = 0;
}

/*******************************************************************************
* 函 数 名: UART_SendString
* 函数功能: 发送字符串
*******************************************************************************/
void UART_SendString(u8 *str)
{
    while (*str != '\0')
    {
        UART_SendByte(*str++);
    }
}

/*******************************************************************************
* 函 数 名: UART_ReceiveByte
* 函数功能: 接收一个字节（非阻塞）
* 返 回 值: 接收到的数据，无数据返回0xFF
*******************************************************************************/
u8 UART_ReceiveByte(void)
{
    u8 dat;
    if (rx_flag)
    {
        dat = rx_buffer;
        rx_flag = 0;
        return dat;
    }
    return 0xFF;
}

/*******************************************************************************
* 函 数 名: UART_ISR
* 函数功能: 串口中断服务函数
*******************************************************************************/
void UART_ISR(void) interrupt 4
{
    if (RI)
    {
        RI = 0;
        rx_buffer = SBUF;
        rx_flag = 1;
    }
}

/*******************************************************************************
* 函 数 名: UART_SetMode
* 函数功能: 设置串口模式开关
*******************************************************************************/
void UART_SetMode(bit enter)
{
    uart_mode = enter;
    if (enter)
    {
        UART_Init();                 // 进入时初始化串口
    }
}

/*******************************************************************************
* 函 数 名: UART_Service
* 函数功能: 串口通信服务函数
* 返 回 值: 收到的数据（0xFF表示无数据）
* 说    明: 收到数据后回显（加1返回），同时返回给调用者用于LCD显示
*******************************************************************************/
u8 UART_Service(void)
{
    u8 rx_data;
    if (!uart_mode) return 0xFF;

    rx_data = UART_ReceiveByte();
    if (rx_data != 0xFF)
    {
        UART_SendByte(rx_data + 1);  // 回显：收到的数据+1
    }
    return rx_data;
}
