#include "lcd1602.h"

/* 函 数 名: delay_ms
功能描述: 软件毫秒级延时函数（@11.0592MHz）*/
void delay_ms(u16 time)
{
    u16 i, j;
    for (i = 0; i < time; i++)
        for (j = 0; j < 113; j++);
}

/*******************************************************************************
* 函 数 名: LCD1602_write_cmd
* 功能描述: 向液晶写控制指令
*******************************************************************************/
void LCD1602_write_cmd(u8 cmd)
{
    LCD1602_RS = 0;             // 选择命令寄存器
    LCD1602_RW = 0;             // 选择写模式
    LCD1602_DATA_PIN = cmd;     // 放置指令字节
    
    // 硬件级稳态时序缓冲
    _nop_(); _nop_();
    LCD1602_E = 1;              // 产生高电平脉冲
    _nop_(); _nop_();
    LCD1602_E = 0;              // 下降沿锁存指令
    
    delay_ms(1);                // 留足1ms指令执行时间
}

/*******************************************************************************
* 函 数 名: LCD1602_write_data
* 功能描述: 向液晶写显示数据
*******************************************************************************/
void LCD1602_write_data(u8 dat)
{
    LCD1602_RS = 1;             // 选择数据寄存器
    LCD1602_RW = 0;             // 选择写模式
    LCD1602_DATA_PIN = dat;     // 放置显示数据字节
    
    // 硬件级稳态时序缓冲
    _nop_(); _nop_();
    LCD1602_E = 1;              // 产生高电平脉冲
    _nop_(); _nop_();
    LCD1602_E = 0;              // 下降沿锁存数据
    
    _nop_(); _nop_();           // 给准双向口留出恢复时间
}

/*******************************************************************************
* 函 数 名: LCD1602_init
* 功能描述: 工业标准上电初始化序列
*******************************************************************************/
void LCD1602_init(void)
{
    delay_ms(15);               // 耐心等待液晶上电物理稳定
    LCD1602_write_cmd(0x38);    // 16*2显示，5*7点阵，8位数据接口
    LCD1602_write_cmd(0x0C);    // 显示开，光标关，闪烁关
    LCD1602_write_cmd(0x06);    // 文字写入后光标自动右移，画面不移动
    LCD1602_write_cmd(0x01);    // 清屏
    delay_ms(2);                // 清屏指令需要较长的处理时间
}

/*******************************************************************************
* 函 数 名: LCD1602_clear
* 功能描述: 快速清屏
*******************************************************************************/
void LCD1602_clear(void)
{
    LCD1602_write_cmd(0x01);    // 写入清屏指令
    delay_ms(2);
}

/*******************************************************************************
* 函 数 名: LCD1602_Position
* 功能描述: 设置显示光标指针坐标
*******************************************************************************/
void LCD1602_Position(u8 row, u8 col)
{
    u8 position;
    row--; col--;               // 将人机直观坐标(1~2, 1~16)转换为标准底层数组坐标(0~1, 0~15)
    if (row == 0)
        position = 0x80 | col;  // 第一行 DDRAM 起始地址 0x00
    else
        position = 0x80 | 0x40 | col; // 第二行 DDRAM 起始地址 0x40
    LCD1602_write_cmd(position);
}

/*******************************************************************************
* 函 数 名: LCD1602_display
* 功能描述: 流式打印字符串
*******************************************************************************/
void LCD1602_display(u8 row, u8 col, u8 *str)
{
    LCD1602_Position(row, col);
    while (*str != '\0')
    {
        LCD1602_write_data(*str++);
    }
}

/*******************************************************************************
* 函 数 名: LCD1602_display_char
* 功能描述: 供主程序超低消耗局部动态刷新数字、小数点、密码星号的核心底层
*******************************************************************************/
void LCD1602_display_char(u8 row, u8 col, u8 ch)
{
    LCD1602_Position(row, col); // 精准定位单个字符坐标
    LCD1602_write_data(ch);     // 仅刷新单点，不影响其余画面，彻底免除清屏闪烁
}