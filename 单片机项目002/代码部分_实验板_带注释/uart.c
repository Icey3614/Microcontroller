#include "uart.h"
#include <string.h>

static u8 idata rx_buffer = 0;       // 接收缓冲
static bit rx_flag = 0;        // 接收完成标志
static bit uart_mode = 0;      // 串口模式标志

/*******************************************************************************
* 函 数 名: UART_Init
* 函数功能: 初始化串口，9600bps @11.0592MHz
* 说    明: 使用T1作为波特率发生器，方式2（8位自动重载）
*******************************************************************************/
void UART_Init(void)
{
/*
	这个初始化函数执行完毕后，单片机的串口硬件就进入了完全就绪的待命状态：
	它时刻盯着自己的引脚，只要电脑用 9600 的波特率发来 8 位的数据，
	它就会自动把数据收好，并触发串口中断 。
*/
    // 串口方式1（8位UART），T1方式2（8位自动重载）
    SCON = 0x50;                     // 方式1, REN=1允许接收，串口通信寄存器
    TMOD = (TMOD & 0x0F) | 0x20;    // T1工作在方式2（8位自动重载）
    TH1 = 0xFD;                      // 9600bps @11.0592MHz
    TL1 = 0xFD;
    TR1 = 1;                         // 启动T1
    ES = 1;                          // 开串口中断
    EA = 1;                          // 开总中断（若已开则无影响）
}

/*******************************************************************************
* 函 数 名: UART_SendByte
* 函数功能: 发送一个字节
*******************************************************************************/
void UART_SendByte(u8 dat)
{
    SBUF = dat;//SBUF（Serial Buffer Register） 是串口数据缓冲寄存器。
//这是一个非常奇妙的硬件寄存器，它“同名不同质”。当向 SBUF 里写入数据时，
//它指向的是发送缓冲区；当从 SBUF 里读取数据时，它指向的是接收缓冲区。
    while (!TI);
//等待发送完成，数据刚送入时T1 = 0，触发阻塞等待，8位数据发送完成后，TI自动取反，结束循环
    TI = 0;//手动设置回到初始状态
}

/*******************************************************************************
* 函 数 名: UART_SendString
* 函数功能: 发送字符串，调用上面的函数，传送字符串
*******************************************************************************/
void UART_SendString(u8 *str)
{
    while (*str != '\0')
    {
        UART_SendByte(*str++);//指针进一位
    }
}

/*******************************************************************************
* 函 数 名: UART_ReceiveByte
* 函数功能: 接收一个字节（非阻塞）
* 返 回 值: 接收到的数据，无数据返回0xFF
*******************************************************************************/
u8 UART_ReceiveByte(void)
{
    u8 dat;
	if (rx_flag)//判断缓冲区是否有数据
    {
			dat = rx_buffer;//接收缓冲区数据
			rx_flag = 0;//清空缓冲区
        return dat;//返回接收的数据
    }
    return 0xFF;//表明当前缓冲区空闲
}

/*******************************************************************************
* 函 数 名: UART_ISR
* 函数功能: 串口中断服务函数
*******************************************************************************/
void UART_ISR(void) interrupt 4//串口硬件中断服务函数
{
    if (RI)//RI（Receive Interrupt flag） 是接收中断标志位
    {
        RI = 0;
        rx_buffer = SBUF;//SBUF 此时充当的是接收缓冲区 。
        rx_flag = 1;//表明接收到数据
    }
}

/*******************************************************************************
* 函 数 名: UART_SetMode
* 函数功能: 设置串口模式开关
*******************************************************************************/
void UART_SetMode(bit enter)
{
    uart_mode = enter;//1代表串口模式，0代表退出
    if (enter)
    {
        UART_Init();                 // 进入时初始化串口
    }
}

/*******************************************************************************
* 函 数 名: UART_Service
* 函数功能: 串口通信服务函数
* 返 回 值: 收到的数据（0xFF表示无数据）
* 说    明: 收到数据后回显（加1返回），同时返回给调用者用于LCD显示
*******************************************************************************/
u8 UART_Service(void)
{
    u8 rx_data;
    if (!uart_mode) return 0xFF;//防御性编程，若该模块未被使用，提前返回，避免执行后续

    rx_data = UART_ReceiveByte();//收到的一字节数据
    if (rx_data != 0xFF)
    {
        UART_SendByte(rx_data + 1);  // 回显：收到的数据+1
    }
    return rx_data;
}
