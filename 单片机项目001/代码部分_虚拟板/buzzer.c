#include "buzzer.h"
#include "timer.h"

// 音律频率表：49个音律对应的 TH1 / TL1 计数初值 [cite: 1001]
static u8 code T[49][2] = {
    {0,0}, // [cite: 1002]
    {0xF9,0x1F},{0xF9,0x82},{0xF9,0xDF},{0xFA,0x37},{0xFA,0x8A},{0xFA,0xD8}, // [cite: 1003]
    {0xFB,0x23},{0xFB,0x68},{0xFB,0xAA},{0xFB,0xE9},{0xFC,0x24},{0xFC,0x5B}, // [cite: 1004]
    {0xFC,0x8F},{0xFC,0xC1},{0xFC,0xEF},{0xFD,0x1B},{0xFD,0x45},{0xFD,0x6C}, // [cite: 1005]
    {0xFD,0x91},{0xFD,0xB4},{0xFD,0xD5},{0xFD,0xF4},{0xFE,0x12},{0xFE,0x2D}, // [cite: 1006]
    {0xFE,0x48},{0xFE,0x60},{0xFE,0x78},{0xFE,0x86},{0xFE,0xA3},{0xFE,0xB6}, // [cite: 1007]
    {0xFE,0xC9},{0xFE,0xDA},{0xFF,0xEB},{0xFE,0xFA},{0xFF,0x09},{0xFF,0x17}, // [cite: 1008]
    {0xFF,0x24},{0xFF,0x30},{0xFF,0x3C},{0xFF,0x47},{0xFF,0x51},{0xFF,0x5B}, // [cite: 1009]
    {0xFF,0x64},{0xFF,0x6D},{0xFF,0x75},{0xFF,0x7D},{0xFF,0x84},{0xFF,0x8B}  // [cite: 1010]
};

// 青花瓷标准曲谱数据：{音律号, 节拍数} [cite: 1012]
static u8 code qinghuaci[][2] = {
    {0,4}, // [cite: 1014]
    {0,1},{1,1},{3,1},{5,1},{6,1},{8,1},{10,1},{12,1},{13,1}, // [cite: 1015]
    {0,1},{13,1},{15,1},{17,1},{18,1},{20,1},{22,1},{24,1},{25,1}, // [cite: 1016]
    {0,1},{25,1},{27,1},{29,1},{30,1},{32,1},{34,1},{36,1},{37,1}, // [cite: 1017]
    {0,1},{37,1},{39,1},{41,1},{42,1},{44,1},{46,1},{48,2}, // [cite: 1018]
    {0,4},{24,4},{24,4},{21,4},{19,4},{21,4},{14,8},{19,4},{21,4},{24,4},{21,4},{19,16}, // [cite: 1019]
    {0,4},{24,4},{24,4},{21,4},{19,4},{21,4},{12,8},{19,4},{21,4},{24,4},{19,4},{17,16}, // [cite: 1020]
    {0,4},{17,4},{19,4},{21,4},{24,4},{26,4},{24,4},{22,4},{24,4},{21,4},{21,4},{19,4},{19,16}, // [cite: 1021]
    {0,4},{17,4},{19,4},{17,4},{17,4},{19,4},{17,4},{19,4},{19,4},{21,8},{24,4},{21,4},{21,12}, // [cite: 1022]
    {0,4},{24,4},{24,4},{21,4},{19,4},{21,4},{14,8},{19,4},{21,4},{24,4},{21,4},{19,16}, // [cite: 1023]
    {0,4},{24,4},{24,4},{21,4},{19,4},{21,4},{12,8},{19,4},{21,4},{24,4},{19,4},{17,16}, // [cite: 1024]
    {0,4},{17,4},{19,4},{21,4},{24,4},{26,4},{24,4},{22,4},{24,4},{21,4},{21,4},{19,4},{19,12}, // [cite: 1025]
    {12,4},{21,8},{19,8},{19,4},{17,20}, // [cite: 1026]
    {0xFF,0xFF} // [cite: 1027]
};

static volatile u8 idata m = 0;               // 当前音符的音律索引 [cite: 1029]
static volatile u16 idata song_index = 0;     // 曲谱数组指针 [cite: 1030]
static volatile bit is_playing = 0;           // 播放状态机开关 [cite: 1031]
static volatile u16 idata beat_ms_remain = 0; // 当前音符总剩余毫秒数 [cite: 1032]

#define BASE_BEAT_MS   35   // 标准基准时序：1/16节拍长度定义为 35 毫秒 [cite: 1033, 1034]
#define SILENT_GAP_MS  15   // 音符末尾强制静音 15 毫秒，用于物理清爽切音，去除模糊感 [cite: 1035, 1036]

/*******************************************************************************
* 函 数 名: T1_ISR_Buzzer (中断号 3)
* 功能描述: 纯净的独立音调发生器，排除Timer0多任务带来的时序挤压 [cite: 1039, 1041]
*******************************************************************************/
void T1_ISR_Buzzer(void) interrupt 3
{
    Beep = !Beep;                // 物理高低电平翻转，驱动被动式蜂鸣器发声 [cite: 1043]
    TH1 = T[m][0];               // 重新装载高8位初值 [cite: 1044]
    TL1 = T[m][1];               // 重新装载低8位初值 [cite: 1045]
}

void Buzzer_PlayQingHuaCi(void)
{
    song_index = 0; // [cite: 1049]
    beat_ms_remain = 0; // [cite: 1050]
    is_playing = 1; // [cite: 1051]
}

void Buzzer_Stop(void)
{
    TR1 = 0;                     // 停止 Timer1 [cite: 1055]
    ET1 = 0;                     // 关闭 Timer1 中断 [cite: 1056]
    is_playing = 0; // [cite: 1057]
    Beep = 1;                    // 强行拉高释放 P2.5 总线，供 LCD1602 正常刷新 [cite: 1058]
}

bit Buzzer_IsPlaying(void)
{
    return is_playing; // [cite: 1062]
}

/*******************************************************************************
* 函 数 名: Buzzer_BeatTick
* 功能描述: 非阻塞毫秒时钟减法器，必须由 Timer0 的 1ms 中断服务程序（T0_ISR）调用 [cite: 1065, 1066]
*******************************************************************************/
void Buzzer_BeatTick(void)
{
    if (is_playing && beat_ms_remain > 0) // [cite: 1070]
    {
        beat_ms_remain--; // [cite: 1072]

        // 核心切音逻辑：当音符即将播放完毕，进入最后的静音窗口时，强行关闭声音 [cite: 1073]
        if (beat_ms_remain <= SILENT_GAP_MS && m != 0) // [cite: 1074]
        {
            TR1 = 0;             // 关闭定时器 [cite: 1076]
            ET1 = 0;             // 关中断 [cite: 1077]
            Beep = 1;            // 释放总线，制造完美声学间隙 [cite: 1078]
        }
    }
}

/*******************************************************************************
* 函 数 名: Buzzer_Service
* 功能描述: 主状态机轮询函数，置于 main.c 的主循环内高效运转 [cite: 1083, 1084]
*******************************************************************************/
void Buzzer_Service(void)
{
    u8 note_type; // [cite: 1088]
    u8 duration; // [cite: 1089]

    if (!is_playing) return; // [cite: 1090]
    if (beat_ms_remain > 0) return; // 当前音符（含切音期）未消耗完毕，直接退出 [cite: 1091]

    // 读取当前谱表节点信息 [cite: 1092]
    note_type = qinghuaci[song_index][0]; // [cite: 1093]
    duration  = qinghuaci[song_index][1]; // [cite: 1094]

    // 1. 判断是否到达歌曲终点 [cite: 1095]
    if (note_type == 0xFF) // [cite: 1096]
    {
        TR1 = 0; ET1 = 0; Beep = 1; // [cite: 1098]
        song_index = 0;                            // 自动回到第一首开头循环播放 [cite: 1099]
        beat_ms_remain = 30 * BASE_BEAT_MS;        // 曲终休止停顿 [cite: 1100]
        return; // [cite: 1101]
    }

    // 2. 解析当前音律并转换为毫秒级时间窗 [cite: 1103]
    m = note_type; // [cite: 1104]
    beat_ms_remain = (u16)duration * BASE_BEAT_MS; // [cite: 1105]

    // 3. 驱动硬件执行对应发声时序 [cite: 1106]
    if (m == 0x00) // 简谱中的休止符 '0' [cite: 1107]
    {
        TR1 = 0; // [cite: 1109]
        ET1 = 0; // [cite: 1110]
        Beep = 1;  // 维持静音 [cite: 1111]
    }
    else           // 有音高振幅的标准音符 [cite: 1113]
    {
        TH1 = T[m][0]; // [cite: 1115]
        TL1 = T[m][1]; // [cite: 1116]
        TR1 = 1;   // 唤醒定时器 [cite: 1117]
        ET1 = 1;   // 开启发声中断 [cite: 1118]
    }

    song_index++;  // 指针无阻塞地平滑递增，指向下一个待播放音符 [cite: 1120]
}