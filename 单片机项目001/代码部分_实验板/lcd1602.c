/*******************************************************************************
 * 模块名称: LCD1602 液晶显示驱动模块（真实实验板全兼容及全局时序修复版）
 * 文件名称: lcd1602.c
 * 优化特性: 
 * 1. 重新实现全局 delay_ms() 函数，彻底根除 main.c 跑飞死机问题。
 * 2. 严格遵循工业标准执行 3 次 0x38 连续唤醒，彻底激活真实硬件的第二行显示。
 * 3. 强行拉低 RW (P2.5)，断绝蜂鸣器复用对液晶内核的电平污染。
 *******************************************************************************/
#include "lcd1602.h"
#include "intrins.h"

#define LCD1602_DATAPORT P0

/*******************************************************************************
 * 函 数 名: delay_ms
 * 功能描述: 【核心修复】：重新向全局释放标准的软件毫秒级延时，解决链接 L1 警告
 *******************************************************************************/
void delay_ms(u16 time)
{
    u16 i, j;
    for (i = 0; i < time; i++)
        for (j = 0; j < 113; j++);
}

/*******************************************************************************
 * 函 数 名: LCD1602_write_cmd
 * 功能描述: 向液晶写入控制指令
 *******************************************************************************/
void LCD1602_write_cmd(u8 cmd)
{
    LCD1602_DATAPORT = 0xFF; // 清空总线，防止残留电平干扰
    LCD1602_RS = 0;          // 选择指令寄存器
    LCD1602_RW = 0;          // 强行拉低RW（强制切回写模式，屏蔽蜂鸣器干扰）
    _nop_();
    
    LCD1602_DATAPORT = cmd;  // 送入指令
    _nop_();
    
    LCD1602_E = 1;           // 拉高使能脚
    _nop_(); _nop_(); _nop_(); // 加宽使能脉冲，照顾真实硬件物理建立时间
    LCD1602_E = 0;           // 捕获下降沿，写入指令
    
    delay_ms(2);             // 留出 2ms 处理指令的时间
}

/*******************************************************************************
 * 函 数 名: LCD1602_write_data
 * 功能描述: 向液晶写入显示内容
 *******************************************************************************/
void LCD1602_write_data(u8 dat)
{
    LCD1602_DATAPORT = 0xFF; 
    LCD1602_RS = 1;          // 选择数据寄存器
    LCD1602_RW = 0;          // 强行拉低RW，屏蔽蜂鸣器干扰
    _nop_();
    
    LCD1602_DATAPORT = dat;  // 送入数据
    _nop_();
    
    LCD1602_E = 1;
    _nop_(); _nop_(); _nop_(); // 加宽使能脉冲
    LCD1602_E = 0;           // 捕获下降沿，写入数据
    
    delay_ms(1);             // 留出 1ms 写入等待
}

/*******************************************************************************
 * 函 数 名: LCD1602_init
 * 功能描述: 工业级 LCD1602 硬件安全唤醒与初始化时序
 *******************************************************************************/
void LCD1602_init(void)
{
    LCD1602_E = 0;
    delay_ms(15);           // 1. 上电后硬件硬延迟 15ms，等待液晶自身电压稳态
    
    // 2. 连续 3 次写入 0x38 强行唤醒并锁死“两行显示模式”
    LCD1602_write_cmd(0x38);
    delay_ms(5);
    LCD1602_write_cmd(0x38);
    delay_ms(5);
    LCD1602_write_cmd(0x38);
    delay_ms(5);
    
    // 3. 此时功能设定正式生效，配置常规显示参数
    LCD1602_write_cmd(0x38); // 开启双行显示，5x7点阵
    LCD1602_write_cmd(0x0C); // 开启无光标显示
    LCD1602_write_cmd(0x06); // 文字输入后光标自动右移
    LCD1602_write_cmd(0x01); // 强清屏
    delay_ms(10);            // 清屏后必须给予长延时
}

/*******************************************************************************
 * 函 数 名: LCD1602_display
 * 功能描述: 动态坐标计算显示英文字串
 *******************************************************************************/
void LCD1602_display(u8 row, u8 col, u8 *str)
{
    u8 addr;
    if (row == 1)
        addr = 0x80 + (col - 1); // 第一行基地址 0x80
    else
        addr = 0xC0 + (col - 1); // 第二行基地址 0xC0

    LCD1602_write_cmd(addr);     // 寻址位置

    while (*str != '\0')
    {
        LCD1602_write_data(*str);
        str++;
    }
}

/*******************************************************************************
 * 函 数 名: LCD1602_display_char
 * 功能描述: 在指定行列位置精准写入单个可见字符
 *******************************************************************************/
void LCD1602_display_char(u8 row, u8 col, u8 chr)
{
    u8 addr;
    if (row == 1)
        addr = 0x80 + (col - 1);
    else
        addr = 0xC0 + (col - 1);

    LCD1602_write_cmd(addr);
    LCD1602_write_data(chr);
}

/*******************************************************************************
 * 函 数 名: LCD1602_clear
 * 功能描述: 全屏一键清除刷新
 *******************************************************************************/
void LCD1602_clear(void)
{
    LCD1602_write_cmd(0x01);
    delay_ms(5); // 给足液晶芯片硬件擦除时间
}